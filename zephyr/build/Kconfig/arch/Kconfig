## zephyr/build/Kconfig/arch/Kconfig
```kconfig
# Load Zephyr Arch Kconfig descriptions.
osource "/home/ludovic/ncs/v3.2.4/zephyr/arch/rx/Kconfig"
osource "/home/ludovic/ncs/v3.2.4/zephyr/arch/x86/Kconfig"
osource "/home/ludovic/ncs/v3.2.4/zephyr/arch/xtensa/Kconfig"
osource "/home/ludovic/ncs/v3.2.4/zephyr/arch/sparc/Kconfig"
osource "/home/ludovic/ncs/v3.2.4/zephyr/arch/riscv/Kconfig"
osource "/home/ludovic/ncs/v3.2.4/zephyr/arch/posix/Kconfig"
osource "/home/ludovic/ncs/v3.2.4/zephyr/arch/mips/Kconfig"
osource "/home/ludovic/ncs/v3.2.4/zephyr/arch/arm64/Kconfig"
osource "/home/ludovic/ncs/v3.2.4/zephyr/arch/arm/Kconfig"
osource "/home/ludovic/ncs/v3.2.4/zephyr/arch/arc/Kconfig"
```

## zephyr/build/Kconfig/boards/Kconfig
```kconfig
# Load Zephyr board Kconfig descriptions.
osource "/home/ludovic/ncs/v3.2.4/zephyr/boards/seeed/xiao_nrf54l15/Kconfig"
```
